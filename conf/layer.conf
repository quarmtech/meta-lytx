## conf/layer.conf
```bitbake
# We have a conf and classes directory, add to BBPATH
BBPATH .= ":${LAYERDIR}"

# We have recipes-* directories, add to BBFILES
BBFILES += "${LAYERDIR}/recipes-*/*/*.bb \
	${LAYERDIR}/recipes-*/*/*.bbappend"

BBFILE_COLLECTIONS += "lytxspl"
BBFILE_PATTERN_lytxspl = "^${LAYERDIR}/"
BBFILE_PRIORITY_lytxspl = "6"
```

## conf/machine/imx6lytx.conf
```bitbake
#@TYPE: Machine
#@NAME: NXP i.MX6Q/DL/S Lytx
#@SOC: i.MX6Q/DL/S
#@DESCRIPTION: Machine configuration for Lytx i.MX6Q/DL/S Boards
#@MAINTAINER: Brett Phagan <b.phagan@nxp.com>
#
# This machine replaces the following machines:
# 
# and is able to work for all the machines.

MACHINEOVERRIDES =. "mx6:mx6q:mx6dl:"

require conf/machine/include/imx-base.inc
require conf/machine/include/tune-cortexa9.inc

KERNEL_DEVICETREE = " \
    imx6qp-sabresd.dtb imx6qp-sabresd-btwifi.dtb imx6qp-sabresd-hdcp.dtb \
    imx6qp-sabresd-ldo.dtb imx6qp-sabresd-ldo-pcie-cert.dtb \
    \
    imx6q-sabresd.dtb imx6q-sabresd-ldo.dtb imx6q-sabresd-hdcp.dtb \
    imx6q-sabresd-enetirq.dtb imx6q-sabresd-btwifi.dtb \
    \
    imx6dl-sabresd.dtb imx6dl-sabresd-ldo.dtb imx6dl-sabresd-hdcp.dtb \
    imx6dl-sabresd-enetirq.dtb imx6dl-sabresd-btwifi.dtb \
"

UBOOT_MACHINE ?= "mx6lytx_defconfig"
UBOOT_MAKE_TARGET = "all"
UBOOT_SUFFIX = "img"
SPL_BINARY = "SPL"

SERIAL_CONSOLE = "115200 ttymxc0"

MACHINE_FIRMWARE_append_mx6 = " linux-firmware-ath6k"

MACHINE_FEATURES += " pci wifi bluetooth"
```
